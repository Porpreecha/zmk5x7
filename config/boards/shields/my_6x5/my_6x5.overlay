/ {
    kscan0: kscan {
        compatible = "zmk,kscan-gpio-matrix";
        diode-direction = "col2row";

        row-gpios = <&gpio0 6 GPIO_ACTIVE_HIGH>,
                    <&gpio0 8 GPIO_ACTIVE_HIGH>,
                    <&gpio0 17 GPIO_ACTIVE_HIGH>,
                    <&gpio0 20 GPIO_ACTIVE_HIGH>,
                    <&gpio0 22 GPIO_ACTIVE_HIGH>;

        col-gpios = <&gpio1 24 GPIO_ACTIVE_HIGH>,
                    <&gpio1 100 GPIO_ACTIVE_HIGH>,
                    <&gpio1 11 GPIO_ACTIVE_HIGH>,
                    <&gpio1 104 GPIO_ACTIVE_HIGH>,
                    <&gpio1 106 GPIO_ACTIVE_HIGH>,
                    <&gpio1 101 GPIO_ACTIVE_HIGH>;
    };

    default_transform: keymap_transform_0 {
        compatible = "zmk,matrix-transform";
        rows = <5>;
        columns = <6>;

        // index = row * columns + col
        map = <
            0 1 2 3 4 5
            6 7 8 9 10 11
            12 13 14 15 16 17
            18 19 20 21 22 23
            24 25 26 27 28 29
        >;
    };

    chosen {
        zmk,kscan = &kscan0;
        zmk,matrix-transform = &default_transform;
    };
};
